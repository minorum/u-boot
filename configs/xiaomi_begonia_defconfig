## configs/xiaomi_begonia_defconfig
```kconfig
CONFIG_ARM=y
CONFIG_SKIP_LOWLEVEL_INIT=y
CONFIG_POSITION_INDEPENDENT=y
CONFIG_ARCH_MEDIATEK=y
CONFIG_TEXT_BASE=0x40080000
CONFIG_SYS_MALLOC_LEN=0x800000
CONFIG_NR_DRAM_BANKS=8
CONFIG_DEFAULT_DEVICE_TREE="mt6785-xiaomi-begonia"
CONFIG_TARGET_MT6785=y
CONFIG_SYS_LOAD_ADDR=0x50000000
CONFIG_WATCHDOG_TIMEOUT_MSECS=10000
CONFIG_BOOTDELAY=-1
CONFIG_BOARD_LATE_INIT=y
CONFIG_CMD_BOOTEFI_SELFTEST=y
CONFIG_CMD_WDT=y
CONFIG_CMD_EFIDEBUG=y
CONFIG_CLK=y
CONFIG_DM_SERIAL=y
CONFIG_MTK_SERIAL=y
CONFIG_WDT=y
CONFIG_WDT_MTK=y
# CONFIG_TOOLS_MKEFICAPSULE is not set
```
