## board/samsung/gt-s5620/Kconfig
```kconfig
if TARGET_GT_S5620

config SYS_BOARD
	default "gt-s5620"

config SYS_VENDOR
	default "samsung"

config SYS_CONFIG_NAME
	default "gt-s5620"

endif
```

## board/samsung/j320fn/Kconfig
```kconfig
if TARGET_SAMSUNG_J320FN || TARGET_SAMSUNG_J320F

config SYS_BOARD
	default "j320fn"

config SYS_VENDOR
	default "samsung"

config SYS_CONFIG_NAME
	default "j320fn"

endif
```

## configs/gt-s5620_defconfig
```kconfig
CONFIG_ARM=y
CONFIG_SYS_DCACHE_OFF=y
CONFIG_TARGET_GT_S5620=y
CONFIG_TEXT_BASE=0x80f00000
CONFIG_SYS_MALLOC_LEN=0x200000
CONFIG_SYS_MALLOC_F_LEN=0x1000
CONFIG_NR_DRAM_BANKS=1
CONFIG_DEFAULT_DEVICE_TREE="broadcom/bcm2153-samsung-gt-s5620"
CONFIG_SYS_LOAD_ADDR=0x84000000
CONFIG_STACK_SIZE=0x20000
CONFIG_EFI_LOADER=y
CONFIG_BOOTDELAY=2
CONFIG_PINCTRL=y
CONFIG_PINCTRL_SINGLE=y
CONFIG_BOOTSTD_DEFAULTS=y
# CONFIG_DISPLAY_CPUINFO is not set
# CONFIG_DISPLAY_BOARDINFO is not set
CONFIG_HUSH_PARSER=y
CONFIG_CMD_MMC=y
CONFIG_CMD_FAT=y
CONFIG_CMD_BOOTZ=y
CONFIG_CMD_PART=y
CONFIG_CMD_EXT4=y
CONFIG_CMD_FS_GENERIC=y
CONFIG_EFI_PARTITION=y
CONFIG_OF_UPSTREAM=y
# CONFIG_NET is not set
CONFIG_CLK=y
CONFIG_DM_I2C=y
CONFIG_DM_PMIC=y
CONFIG_DM_REGULATOR=y
CONFIG_DM_PMIC_BCM59035=y
CONFIG_SYS_I2C_BCM2153=y
CONFIG_MMC_SDHCI=y
CONFIG_MMC_SDHCI_BCM2153=y
# CONFIG_REQUIRE_SERIAL_CONSOLE is not set
CONFIG_DM_SERIAL=y
CONFIG_VIDEO=y
CONFIG_VIDEO_DAMAGE=y
CONFIG_VIDEO_SYNC_MS=16
CONFIG_VIDEO_BPP16=y
# CONFIG_VIDEO_LOGO is not set
CONFIG_SYS_WHITE_ON_BLACK=y
CONFIG_SYS_CONSOLE_IS_IN_ENV=y
CONFIG_SYS_DEVICE_NULLDEV=y
CONFIG_DISPLAY_BOARDINFO_LATE=y
CONFIG_BOARD_LATE_INIT=y
CONFIG_USB=y
CONFIG_USB_GADGET=y
# CONFIG_DM_USB_GADGET is not set
CONFIG_USB_GADGET_DWC2_OTG=y
CONFIG_USB_GADGET_DOWNLOAD=y
CONFIG_USB_FUNCTION_ACM=y
CONFIG_USB_GADGET_VENDOR_NUM=0x0525
CONFIG_USB_GADGET_PRODUCT_NUM=0xa4a7
CONFIG_USB_GADGET_MANUFACTURER="GT-S5620 U-Boot"
CONFIG_SYSRESET=y
CONFIG_SYSRESET_BCM2153=y
CONFIG_WDT=y
CONFIG_WDT_BCM2153=y
CONFIG_WATCHDOG=y
CONFIG_CMD_WDT=y
CONFIG_TIMER=y
CONFIG_BCM2153_TIMER=y
# CONFIG_TOOLS_MKEFICAPSULE is not set
```

## configs/modecom_freetab8001_ram_defconfig
```kconfig
CONFIG_ARM=y
CONFIG_ARCH_MEDIATEK=y
CONFIG_TARGET_MT6577=y
CONFIG_TEXT_BASE=0x10010000
CONFIG_POSITION_INDEPENDENT=y
CONFIG_SYS_MALLOC_LEN=0x200000
CONFIG_SYS_MALLOC_F_LEN=0x4000
CONFIG_STACK_SIZE=0x100000
CONFIG_NR_DRAM_BANKS=4
CONFIG_HAS_CUSTOM_SYS_INIT_SP_ADDR=y
CONFIG_CUSTOM_SYS_INIT_SP_ADDR=0x10fff000
CONFIG_DEFAULT_DEVICE_TREE="mt6577-modecom-freetab8001-ram"
CONFIG_SYS_LOAD_ADDR=0x10400000
CONFIG_SKIP_LOWLEVEL_INIT_ONLY=y
CONFIG_BOARD_EARLY_INIT_F=y
CONFIG_OF_BOARD_FIXUP=y
CONFIG_OF_BOARD_SETUP=y
CONFIG_BOOTDELAY=-2
CONFIG_USE_BOOTCOMMAND=y
CONFIG_BOOTCOMMAND="version; bdinfo"
# CONFIG_CONSOLE_MUX is not set
CONFIG_SYS_CONSOLE_IS_IN_ENV=y
CONFIG_SYS_DEVICE_NULLDEV=y
CONFIG_ENV_IS_NOWHERE=y
# CONFIG_DISPLAY_CPUINFO is not set
# CONFIG_CYCLIC is not set
CONFIG_CMD_HASH=y
CONFIG_SHA256=y
CONFIG_CMD_TIME=y
# CONFIG_CMD_CLS is not set
CONFIG_CLK=y
CONFIG_DM_GPIO=y
CONFIG_CMD_GPIO=y
CONFIG_PINCTRL=y
CONFIG_PINCONF=y
CONFIG_PINCTRL_MT6577=y
CONFIG_CMD_PINMUX=y
CONFIG_CMD_CLK=y
CONFIG_MTK_SERIAL=y
CONFIG_VIDEO=y
CONFIG_VIDEO_MT6577=y
CONFIG_PANEL_MODECOM_FREETAB8001=y
CONFIG_BACKLIGHT_GPIO=y
# CONFIG_VIDEO_BPP8 is not set
# CONFIG_VIDEO_BPP32 is not set
CONFIG_CMD_BIND=y
CONFIG_DM_I2C=y
CONFIG_SYS_I2C_MT6577_DUAL=y
CONFIG_CMD_I2C=y
CONFIG_DM_PMIC=y
CONFIG_DM_CHARGER=y
CONFIG_CHARGER_NCP1851=y
CONFIG_PMIC_MT6329=y
CONFIG_ADC=y
CONFIG_ADC_MT6329=y
CONFIG_CMD_ADC=y
CONFIG_DM_THERMAL=y
CONFIG_GENERIC_ADC_THERMAL=y
CONFIG_CMD_TEMPERATURE=y
CONFIG_CMD_CHARGER=y
CONFIG_DM_REGULATOR=y
CONFIG_REGULATOR_MT6329=y
CONFIG_CMD_PMIC=y
CONFIG_CMD_REGULATOR=y
CONFIG_MMC=y
CONFIG_MMC_MTK=y
CONFIG_PWRSEQ=y
CONFIG_FS_LOADER=y
CONFIG_PWRSEQ_MT6628=y
CONFIG_MMC_WRITE=y
CONFIG_MMC_SPEED_MODE_SET=y
# CONFIG_MMC_HW_PARTITIONING is not set
# CONFIG_SUPPORT_EMMC_BOOT is not set
# CONFIG_SUPPORT_EMMC_RPMB is not set
CONFIG_CMD_MMC=y
CONFIG_CMD_MMC_REG=y
CONFIG_DM_SERIAL=y
CONFIG_SERIAL_PRESENT=y
# CONFIG_SERIAL_CONSOLE is not set
# CONFIG_REQUIRE_SERIAL_CONSOLE is not set
CONFIG_TIMER=y
CONFIG_MTK_TIMER=y
CONFIG_USB=y
CONFIG_DM_USB_GADGET=y
CONFIG_USB_GADGET=y
CONFIG_USB_GADGET_VBUS_DRAW=500
CONFIG_USB_GADGET_MANUFACTURER="MODECOM RAM bring-up"
CONFIG_USB_GADGET_VENDOR_NUM=0x0525
CONFIG_USB_GADGET_PRODUCT_NUM=0xa4a7
CONFIG_USB_GADGET_DOWNLOAD=y
CONFIG_USB_FUNCTION_ACM=y
CONFIG_USB_MUSB_GADGET=y
CONFIG_PHY=y
CONFIG_PHY_MT6577_USB=y
CONFIG_USB_MUSB_MT6577=y
CONFIG_USB_MUSB_PIO_ONLY=y
# CONFIG_TOOLS_MKEFICAPSULE is not set
# CONFIG_EFI_GRUB_ARM32_WORKAROUND is not set
```

## configs/samsung_j320f_defconfig
```kconfig
CONFIG_ARM=y
CONFIG_TARGET_SAMSUNG_J320F=y
CONFIG_TEXT_BASE=0x80008000
CONFIG_SYS_MALLOC_LEN=0x200000
CONFIG_NR_DRAM_BANKS=1
CONFIG_HAS_CUSTOM_SYS_INIT_SP_ADDR=y
CONFIG_CUSTOM_SYS_INIT_SP_ADDR=0x85300000
CONFIG_DEFAULT_DEVICE_TREE="sc9830-samsung-j320f"
CONFIG_SYS_LOAD_ADDR=0x81000000
CONFIG_SYS_DCACHE_OFF=y
CONFIG_SYS_L2CACHE_OFF=y
# CONFIG_ARMV7_NONSEC is not set
# CONFIG_EFI_LOADER is not set
# CONFIG_DISPLAY_CPUINFO is not set
# CONFIG_DISPLAY_BOARDINFO is not set
CONFIG_USE_BOOTCOMMAND=y
CONFIG_BOOTCOMMAND="bootflow scan -b mmc0:27; fastboot usb 0"
CONFIG_BOOTDELAY=0
CONFIG_BOARD_LATE_INIT=y
CONFIG_DM_REBOOT_MODE=y
CONFIG_HUSH_PARSER=y
CONFIG_CMD_GETTIME=y
CONFIG_CMD_BOOTZ=y
CONFIG_SUPPORT_RAW_INITRD=y
CONFIG_BOOTSTD=y
CONFIG_BOOTSTD_FULL=y
CONFIG_BOOTMETH_EXTLINUX=y
CONFIG_CMD_BOOTFLOW=y
CONFIG_CMD_MMC=y
CONFIG_CMD_PART=y
CONFIG_CMD_EXT4=y
CONFIG_EFI_PARTITION=y
CONFIG_MMC_SDHCI=y
CONFIG_MMC_SDHCI_SDMA=y
# CONFIG_MMC_SDHCI_ADMA is not set
# CONFIG_ARCH_FIXUP_FDT_MEMORY is not set
CONFIG_ENV_IS_NOWHERE=y
CONFIG_SYSRESET=y
CONFIG_VIDEO=y
CONFIG_VIDEO_SIMPLE=y
# CONFIG_VIDEO_LOGO is not set
# CONFIG_VIDEO_FONT_8X16 is not set
CONFIG_VIDEO_FONT_16X32=y
CONFIG_SYS_WHITE_ON_BLACK=y
CONFIG_ENV_SOURCE_FILE="samsung_j320f"
# CONFIG_NET is not set
# CONFIG_REQUIRE_SERIAL_CONSOLE is not set
CONFIG_USB=y
CONFIG_DM_USB=y
CONFIG_DM_USB_GADGET=y
CONFIG_USB_GADGET=y
CONFIG_USB_GADGET_DWC2_OTG=y
CONFIG_USB_GADGET_DOWNLOAD=y
CONFIG_USB_GADGET_VENDOR_NUM=0x1209
CONFIG_USB_GADGET_PRODUCT_NUM=0x4a33
CONFIG_USB_GADGET_MANUFACTURER="J320F U-Boot development"
CONFIG_USB_FUNCTION_FASTBOOT=y
CONFIG_CONSOLE_RECORD=y
CONFIG_FASTBOOT_CMD_OEM_CONSOLE=y
CONFIG_FASTBOOT_BUF_ADDR=0x81000000
CONFIG_FASTBOOT_BUF_SIZE=0x04000000
```

## drivers/pinctrl/mediatek/Kconfig
```kconfig
if ARCH_MEDIATEK

config PINCTRL_MTK
	depends on PINCTRL_GENERIC
	select REGMAP
	select SYSCON
	bool

config PINCTRL_MT6577
	bool "MT6577 SoC pinctrl driver"
	select PINCTRL_MTK
	help
	  Support MT6577 GPIO control through the MediaTek pin controller.
	  Provide GPIO-mode selection, direction and pin value operations.
	  Use the standard driver-model GPIO and pinctrl interfaces.
	  Preserve firmware pin configuration until a GPIO is requested.

config PINCTRL_MT7622
	bool "MT7622 SoC pinctrl driver"
	select PINCTRL_MTK

config PINCTRL_MT7623
	bool "MT7623 SoC pinctrl driver"
	select PINCTRL_MTK

config PINCTRL_MT7629
	bool "MT7629 SoC pinctrl driver"
	select PINCTRL_MTK

config PINCTRL_MT7981
	bool "MT7981 SoC pinctrl driver"
	select PINCTRL_MTK

config PINCTRL_MT7986
	bool "MT7986 SoC pinctrl driver"
	select PINCTRL_MTK

config PINCTRL_MT7987
	bool "MT7987 SoC pinctrl driver"
	select PINCTRL_MTK

config PINCTRL_MT7988
	bool "MT7988 SoC pinctrl driver"
	select PINCTRL_MTK

config PINCTRL_MT8188
	bool "MT8188 SoC pinctrl driver"
	select PINCTRL_MTK

config PINCTRL_MT8195
	bool "MT8195 SoC pinctrl driver"
	select PINCTRL_MTK

config PINCTRL_MT8189
	bool "MT8189 SoC pinctrl driver"
	select PINCTRL_MTK

config PINCTRL_MT8365
	bool "MT8365 SoC pinctrl driver"
	select PINCTRL_MTK

config PINCTRL_MT8512
	bool "MT8512 SoC pinctrl driver"
	select PINCTRL_MTK

config PINCTRL_MT8516
	bool "MT8516 SoC pinctrl driver"
	select PINCTRL_MTK

config PINCTRL_MT8518
	bool "MT8518 SoC pinctrl driver"
	select PINCTRL_MTK

endif
```

## drivers/power/charger/Kconfig
```kconfig
config DM_CHARGER
	bool "Driver model battery chargers"
	depends on DM
	help
	  Provide charger status and input-current authorization through driver
	  model. Current budgets use microamps and include zero authorization.
	  Battery measurements and protections remain with the chip driver.
	  This interface does not infer battery limits or available USB current.

config CHARGER_NCP1851
	bool "ON Semiconductor NCP1851 charger"
	depends on DM_CHARGER && DM_I2C && ADC && DM_THERMAL
	select CYCLIC
	help
	  Support NCP1851 and NCP1851A single-cell chargers with external ADC
	  voltage and thermal monitoring. Explicit battery limits are required.
	  Periodic safety checks service the hardware watchdog while charging.
	  USB input authorization is supplied through the charger interface.
```
